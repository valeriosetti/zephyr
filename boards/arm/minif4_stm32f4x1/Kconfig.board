## boards/arm/minif4_stm32f4x1/Kconfig.board
```kconfig
# MINIF4 F401 board configuration

# Copyright (c) 2016 Linaro Limited.
# SPDX-License-Identifier: Apache-2.0

config BOARD_MINI_F401
	bool "WeAct studio STM32F4x1 MiniF4 Development Board"
	depends on SOC_STM32F401XC
```

## boards/arm/minif4_stm32f4x1/Kconfig.defconfig
```kconfig
# NUCLEO-64 F401 board configuration

# Copyright (c) 2016 Linaro Limited.
# Copyright (c) 2019 Centaur Analytics, Inc
# SPDX-License-Identifier: Apache-2.0

if BOARD_MINI_F401

config BOARD
	default "minif4_f401"

endif # BOARD_MINI_F401
```

## modules/mbedtls/Kconfig.extra
```kconfig
# Copyright (c) 2024 BayLibre SAS
# SPDX-License-Identifier: Apache-2.0

# Extra options the are not strictly necessary for Mbed TLS itself, but that
# configure it properly for other modules/subsystems.

config MBEDTLS_OPENTHREAD_OPTIMIZATIONS_ENABLED
	bool "MbedTLS optimizations for OpenThread"
	depends on NET_L2_OPENTHREAD
	default y if !NET_SOCKETS_SOCKOPT_TLS
	help
	  Enable some OpenThread specific mbedTLS optimizations that allows to
	  save some RAM/ROM when OpenThread is used. Note, that when application
	  aims to use other mbedTLS services on top of OpenThread (e.g. secure
	  sockets), it's advised to disable this option.
```
